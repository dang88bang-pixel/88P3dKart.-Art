## CMakeLists.txt
```
cmake_minimum_required(VERSION 3.20.0)

find_package(Zephyr REQUIRED HINTS $ENV{ZEPHYR_BASE})
project(3dxagent_ble_accessories)

# ─── Quellen ─────────────────────────────────────────────────
target_sources(app PRIVATE
    src/main.c
    src/common/battery.c
    src/common/button.c
    src/common/advertising.c
    src/common/gatt_custom.c
    src/profiles/token_profile.c
    src/profiles/sensor_profile.c
    src/profiles/wearable_profile.c
    src/profiles/asset_tag_profile.c
    src/profiles/remote_profile.c
    src/profiles/gateway_profile.c
)

# Includes
target_include_directories(app PRIVATE
    src/common
    src/profiles
    src
)

zephyr_library_include_directories(src)
```

## Kconfig
```
# 3dxAgent Bluetooth Zubehör Kconfig

mainmenu "3dxAgent BLE Zubehör Firmware (nRF52840)"

config ACCESSORY_TYPE
    string "Accessory Type Name"
    default "3dxAgent-Token"

choice ACCESSORY_SELECT
    prompt "Bluetooth Zubehör Typ"
    default ACCESSORY_TYPE_TOKEN

config ACCESSORY_TYPE_TOKEN
    bool "Token Classic/Pro – IMU + Batterie + Temperatur (Standard)"

config ACCESSORY_TYPE_SENSOR_TAG
    bool "Sensor Tag – BME280/SHT4x Umwelt (Temp/Feuchte/Druck/Luft)"

config ACCESSORY_TYPE_WEARABLE
    bool "Wearable – HRM + Steps + IMU"

config ACCESSORY_TYPE_ASSET_TAG
    bool "Asset Tag – iBeacon + Eddystone"

config ACCESSORY_TYPE_REMOTE
    bool "Remote Controller – Buttons + Joystick"

config ACCESSORY_TYPE_GATEWAY
    bool "Gateway Bridge – Scanner Rolle BLE→MQTT"

endchoice

config PROTOCOL_VERSION
    int "Protokoll Version (1=legacy 9B, 2=extended 16B+)"
    default 2

config ADV_INTERVAL_MS
    int "Advertising Intervall ms im Normalbetrieb"
    default 200

config ADV_INTERVAL_MOVING_MS
    int "Advertising Intervall ms bei Bewegung"
    default 100

config ADV_INTERVAL_SOS_MS
    int "Advertising Intervall ms bei SOS"
    default 50

config ENABLE_GATT_SERVICE
    bool "Aktiviere Custom GATT Service (Data/Config/Command)"
    default y

config ENABLE_BATTERY_SERVICE
    bool "Battery Service 0x180F"
    default y

config ENABLE_DEVICE_INFO
    bool "Device Info Service"
    default y

config ENABLE_I2C_SENSORS
    bool "I2C Sensoren aktivieren (BME280, BMI270)"
    default y

config HAS_BUTTON
    bool "Board hat SOS/Button"
    default y

config HAS_LED
    bool "Board hat LED für Status"
    default y

config LOW_BATTERY_THRESHOLD
    int "Low Battery Schwelle %"
    default 15

source "Kconfig.zephyr"
```

## prj.conf
```kconfig
# 3dxAgent BLE Zubehör Firmware – nRF52840 + BMI270 + BME280
# Unterstützt: Token, Sensor-Tag, Wearable, Asset-Tag, Remote, Gateway

CONFIG_BT=y
CONFIG_BT_PERIPHERAL=y
CONFIG_BT_BROADCASTER=y
CONFIG_BT_OBSERVER=y
CONFIG_BT_CENTRAL=y
CONFIG_BT_DEVICE_NAME="3dxAgent-Zubehör"
CONFIG_BT_DEVICE_NAME_DYNAMIC=y
CONFIG_BT_MAX_CONN=2
CONFIG_BT_MAX_PAIRED=4
CONFIG_BT_L2CAP_TX_MTU=247

CONFIG_BT_EXT_ADV=y
CONFIG_BT_EXT_ADV_MAX_ADV_SET=3
CONFIG_BT_GATT_CLIENT=y

CONFIG_BT_SMP=y
CONFIG_BT_CONN_TX_MAX=5

CONFIG_BT_BAS=y
CONFIG_BT_DIS=y
CONFIG_BT_DIS_FW_REV=y
CONFIG_BT_ESS=y
CONFIG_BT_HRS=y

CONFIG_SENSOR=y
CONFIG_BMI270=y
CONFIG_BME280=y
CONFIG_BME280_TRIGGER_NONE=y
CONFIG_SHT4X=y
CONFIG_I2C=y
CONFIG_I2C_NRFX=y

CONFIG_GPIO=y
CONFIG_ADC=y
CONFIG_ADC_NRFX_SAADC=y

CONFIG_BT_SETTINGS=y
CONFIG_SETTINGS=y
CONFIG_SETTINGS_FS=y
CONFIG_FILE_SYSTEM=y
CONFIG_FILE_SYSTEM_LITTLEFS=y
CONFIG_FS_LITTLEFS=y
CONFIG_FLASH=y
CONFIG_FLASH_MAP=y
CONFIG_FCB=y

CONFIG_BT_GATT_CACHING=n

CONFIG_LOG=y
CONFIG_LOG_DEFAULT_LEVEL=3
CONFIG_USE_SEGGER_RTT=y
CONFIG_LOG_BACKEND_RTT=y
CONFIG_LOG_BACKEND_UART=n

CONFIG_HEAP_MEM_POOL_SIZE=16384
CONFIG_MAIN_STACK_SIZE=2048
CONFIG_SYSTEM_WORKQUEUE_STACK_SIZE=2048

CONFIG_FPU=y

# Power Management
CONFIG_PM=y
CONFIG_PM_DEVICE=y
CONFIG_PM_DEVICE_RUNTIME=y

# Defaults – überschreibbar via Kconfig / board overlay
CONFIG_ACCESSORY_TYPE_TOKEN=y
CONFIG_PROTOCOL_VERSION=2
CONFIG_ADV_INTERVAL_MS=200
CONFIG_ENABLE_GATT_SERVICE=y
CONFIG_ENABLE_BATTERY_SERVICE=y
CONFIG_ENABLE_DEVICE_INFO=y
CONFIG_HAS_BUTTON=y
CONFIG_HAS_LED=y
CONFIG_LOW_BATTERY_THRESHOLD=15

CONFIG_CPLUSPLUS=n
```

## src/main.c
```c
/*
 * 3dxAgent BLE token (nRF52840 + BMI270)
 *
 * Versioned manufacturer data, little-endian:
 *   0..1   Bluetooth company ID (0x0059; removed by Android ScanRecord)
 *   2      protocol version (1)
 *   3      flags: bit 0 battery valid, bit 1 IMU valid
 *   4..5   sequence (uint16)
 *   6..7   acceleration X (int16, milli-m/s²)
 *   8..9   acceleration Y (int16, milli-m/s²)
 *   10..11 acceleration Z (int16, milli-m/s²)
 *   12     battery percent, or 0xFF when unavailable
 *
 * Battery telemetry is explicitly unavailable until a board overlay defines a
 * calibrated battery-divider ADC channel. The firmware never advertises a
 * fabricated percentage.
 */
#include <limits.h>
#include <stdint.h>

#include <zephyr/bluetooth/bluetooth.h>
#include <zephyr/drivers/sensor.h>
#include <zephyr/kernel.h>
#include <zephyr/logging/log.h>
#include <zephyr/sys/util.h>

#include "common/battery.h"
#include "common/button.h"
#include "common/advertising.h"
#include "common/gatt_custom.h"

#define COMPANY_ID 0x0059
#define PROTOCOL_VERSION 1
#define FLAG_BATTERY_VALID BIT(0)
#define FLAG_IMU_VALID BIT(1)
#define BATTERY_UNKNOWN 0xFF
#define ADV_UPDATE_INTERVAL K_MSEC(200)

struct __packed token_payload {
    uint8_t company_id_le[2];
    uint8_t version;
    uint8_t flags;
    uint8_t sequence_le[2];
    uint8_t accel_x_le[2];
    uint8_t accel_y_le[2];
    uint8_t accel_z_le[2];
    uint8_t battery_percent;
};

BUILD_ASSERT(sizeof(struct token_payload) == 13,
             "token manufacturer payload has changed");

LOG_MODULE_REGISTER(main, LOG_LEVEL_INF);

#if DT_NODE_EXISTS(DT_NODELABEL(bmi270))
static const struct device *imu = DEVICE_DT_GET(DT_NODELABEL(bmi270));
#else
static const struct device *imu;
#endif

static void put_u16_le(uint8_t destination[2], uint16_t value)
{
    destination[0] = (uint8_t)(value & 0xff);
    destination[1] = (uint8_t)(value >> 8);
}

static int16_t acceleration_milli_ms2(const struct sensor_value *value)
{
    double scaled = sensor_value_to_double(value) * 1000.0;

    if (scaled > INT16_MAX) {
        return INT16_MAX;
    }
    if (scaled < INT16_MIN) {
        return INT16_MIN;
    }
    return (int16_t)scaled;
}

static bool read_acceleration(struct token_payload *payload)
{
    struct sensor_value accel[3];

    if (imu == NULL || !device_is_ready(imu) || sensor_sample_fetch(imu) != 0 ||
        sensor_channel_get(imu, SENSOR_CHAN_ACCEL_X, &accel[0]) != 0 ||
        sensor_channel_get(imu, SENSOR_CHAN_ACCEL_Y, &accel[1]) != 0 ||
        sensor_channel_get(imu, SENSOR_CHAN_ACCEL_Z, &accel[2]) != 0) {
        return false;
    }

    put_u16_le(payload->accel_x_le,
               (uint16_t)acceleration_milli_ms2(&accel[0]));
    put_u16_le(payload->accel_y_le,
               (uint16_t)acceleration_milli_ms2(&accel[1]));
    put_u16_le(payload->accel_z_le,
               (uint16_t)acceleration_milli_ms2(&accel[2]));
    return true;
}

int main(void)
{
    int err;
    uint16_t sequence = 0;
    struct token_payload payload = {
        .company_id_le = { COMPANY_ID & 0xff, COMPANY_ID >> 8 },
        .version = PROTOCOL_VERSION,
        .battery_percent = BATTERY_UNKNOWN,
    };
    struct bt_data advertising_data[] = {
        BT_DATA(BT_DATA_MANUFACTURER_DATA, &payload, sizeof(payload)),
    };

    err = bt_enable(NULL);
    if (err != 0) {
        LOG_ERR("Bluetooth init failed (err %d)", err);
        return err;
    }

    if (imu == NULL || !device_is_ready(imu)) {
        LOG_WRN("BMI270 unavailable; IMU-valid flag will remain clear");
    }

    /* Start once. Subsequent samples update the active advertising set. */
    err = bt_le_adv_start(&adv_param, advertising_data,
                          ARRAY_SIZE(advertising_data), NULL, 0);
    if (err != 0) {
        LOG_ERR("Advertising start failed (err %d)", err);
        return err;
    }

    LOG_INF("BLE token advertising protocol v%d", PROTOCOL_VERSION);

    while (true) {
        payload.flags = 0;
        put_u16_le(payload.sequence_le, sequence++);
        put_u16_le(payload.accel_x_le, 0);
        put_u16_le(payload.accel_y_le, 0);
        put_u16_le(payload.accel_z_le, 0);
        payload.battery_percent = BATTERY_UNKNOWN;

        if (read_acceleration(&payload)) {
            payload.flags |= FLAG_IMU_VALID;
        }

        err = bt_le_adv_update_data(advertising_data,
                                    ARRAY_SIZE(advertising_data), NULL, 0);
        if (err != 0) {
            LOG_WRN("Advertising update failed (err %d)", err);
        }

        k_sleep(ADV_UPDATE_INTERVAL);
    }

    return 0;
}
```
